## sources/imx/meta-3rd-party/conf/layer.conf
```bitbake
# We have a conf and classes directory, add to BBPATH
BBPATH .= ":${LAYERDIR}"

# We have recipes-* directories, add to BBFILES
BBFILES += "${LAYERDIR}/recipes-*/*/*.bb \
        ${LAYERDIR}/recipes-*/*/*.bbappend"

BBFILE_COLLECTIONS += "3rd-party"
BBFILE_PATTERN_3rd-party = "^${LAYERDIR}/"
BBFILE_PRIORITY_3rd-party = "6"
LAYERSERIES_COMPAT_3rd-party = "sumo"
```

## sources/imx/meta-app/conf/distro/app.conf
```bitbake
require conf/distro/poky.conf

DISTRO = "app"
# These get overwritten in base-files bbappend recipe
DISTRO_NAME = "App distro"
DISTRO_VERSION = "1.0.0"
```

## sources/imx/meta-app/conf/layer.conf
```bitbake
# We have a conf and classes directory, add to BBPATH
BBPATH .= ":${LAYERDIR}"

# We have recipes-* directories, add to BBFILES
BBFILES += "${LAYERDIR}/recipes-*/*/*.bb \
        ${LAYERDIR}/recipes-*/*/*.bbappend"

BBFILE_COLLECTIONS += "app"
BBFILE_PATTERN_app = "^${LAYERDIR}/"
BBFILE_PRIORITY_app = "6"
LAYERSERIES_COMPAT_app = "sumo"

LICENSE_PATH += "${LAYERDIR}/custom-licenses"
```

## sources/imx/meta-imx-bsp/conf/layer.conf
```bitbake
# We have a conf and classes directory, add to BBPATH
BBPATH := "${BBPATH}:${LAYERDIR}"

# We have a packages directory, add to BBFILES
BBFILES := "${BBFILES} ${LAYERDIR}/common/recipes-*/*/*.bb \
            ${LAYERDIR}/common/recipes-*/*/*.bbappend"

BBFILE_COLLECTIONS += "imxbsp"
BBFILE_PATTERN_imxbsp := "^${LAYERDIR}/"
BBFILE_PRIORITY_imxbsp = "6"
LAYERSERIES_COMPAT_imxbsp = "sumo"
```

## sources/imx/meta-imx-bsp/conf/machine/hwasin.conf
```bitbake
#@TYPE: Machine
#@NAME: hwasin 

#@DESCRIPTION: Machine configuration for eolus systemsCHINEOVERRIDES =. "mx6:mx6ull:"

include conf/machine/include/imx-base.inc
include conf/machine/include/tune-cortexa7.inc

KERNEL_DEVICETREE = "hwasin.dtb hwasin-emmc.dtb hwasin-emmc-hdmi.dtb"

UBOOT_CONFIG ??= "sd emmc"
UBOOT_CONFIG[sd] = "hwasin_config,sdcard"
UBOOT_CONFIG[emmc] = "hwasin_emmc_defconfig,sdcard"
UBOOT_CONFIG[mfgtool] = "hwasin_config"

PREFERRED_PROVIDER_u-boot = "u-boot-imx"
PREFERRED_PROVIDER_virtual/bootloader = "u-boot-imx"
PREFERRED_PROVIDER_virtual/kernel = "linux-imx"

KERNEL_DEFCONFIG = "${WORKDIR}/defconfig"

SERIAL_CONSOLE = "115200 ttymxc0"

MACHINE_FEATURES += "wifi"

IMAGE_CLASSES = "image_types_app"
IMAGE_FSTYPES = " tar.gz squashfs squashfs.run"
IMAGE_FSTYPES_remove = "squashfs"

INITRAMFS_IMAGE = "imx-image-initramfs"
INITRAMFS_FSTYPES = "cpio.gz.u-boot"

MACHINE_EXTRA_RRECOMMENDS = "kernel-modules"

EXTRA_IMAGEDEPENDS += "u-boot"
```

## sources/imx/meta-imx-bsp/meta-freescale/conf/layer.conf
```bitbake
# We have a conf and classes directory, add to BBPATH
BBPATH .= ":${LAYERDIR}"

# We have recipes-* directories, add to BBFILES
BBFILES += "${LAYERDIR}/recipes-*/*/*.bb ${LAYERDIR}/recipes-*/*/*.bbappend"

BBFILE_COLLECTIONS += "bsp-freescale"
BBFILE_PATTERN_bsp-freescale := "^${LAYERDIR}/"
BBFILE_PRIORITY_bsp-freescale = "6"

LAYERSERIES_COMPAT_bsp-freescale = "sumo"
```

## sources/imx/meta-imx-bsp/meta-freescale/recipes-boot/u-boot/u-boot-imx_2017.03/new-files/board/freescale/hwasin/Kconfig
```kconfig
if TARGET_HWASIN

config SYS_BOARD
	default "hwasin"

config SYS_VENDOR
	default "freescale"

config SYS_CONFIG_NAME
	default "hwasin"

endif
```

## sources/imx/meta-imx-bsp/meta-hwasin/conf/layer.conf
```bitbake
# We have a conf and classes directory, add to BBPATH
BBPATH .= ":${LAYERDIR}"

# We have a recipes-* directories, add to BBFILES
BBFILES += "${LAYERDIR}/recipes-*/*/*.bb \
    ${LAYERDIR}/recipes-*/*/*.bbappend"

BBFILE_COLLECTIONS += "meta-hwasin"
BBFILE_PATTERN_meta-hwasin = "^${LAYERDIR}/"
BBFILE_PRIORITY_meta-hwasin = "6"

LAYERSERIES_COMPAT_meta-hwasin = "sumo"

BBFILE_PATTERN_IGNORE_EMPTY_meta-hwasin = "1"
```

## sources/imx/meta-imx-images/conf/layer.conf
```bitbake
# We have a packages directory, add to BBFILES
BBPATH := "${BBPATH}:${LAYERDIR}"

BBFILES += "${LAYERDIR}/recipes-*/*/*.bb*"
BBFILES += "${LAYERDIR}/recipes-*/*/*.bbappend"

BBFILE_COLLECTIONS += "imx-images"
BBFILE_PATTERN_imx-images := "^${LAYERDIR}/"
BBFILE_PRIORITY_imx-images = "6"

LAYERSERIES_COMPAT_imx-images = "sumo"
```
